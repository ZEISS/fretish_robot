## CMakeLists.txt
```
# SPDX-License-Identifier: Apache-2.0

cmake_minimum_required(VERSION 3.20.0)
find_package(Zephyr REQUIRED HINTS $ENV{ZEPHYR_BASE})
project(digital_microscope)

target_sources(app PRIVATE src/main.c)
```

## west.yml
```
# SPDX-FileCopyrightText: Copyright (c) 2024 Carl Zeiss Meditec AG
# SPDX-License-Identifier: Apache-2.0

manifest:
  version: "0.13"

  # If not otherwise specified, the projects below should be obtained
  # from the ZEISS remote.
  defaults:
    remote: origin

  remotes:
    - name: origin
      url-base: https://github.com/ZEISS

  projects:
    - name: zephyr
      remote: origin
      revision: zeiss/fretish_robot
      west-commands: scripts/west-commands.yml
```

## prj.conf
```kconfig
CONFIG_PRINTK=y
CONFIG_LOG=y

CONFIG_SHELL=y
CONFIG_SHELL_BACKEND_SERIAL=y
CONFIG_SHELL_MINIMAL=y
CONFIG_SHELL_STACK_SIZE=1024
```

## src/main.c
```c
/*
 * SPDX-FileCopyrightText: Copyright (c) 2024 Carl Zeiss Meditec AG
 *
 * SPDX-License-Identifier: Apache-2.0
 */

#include <zephyr/kernel.h>
#include <zephyr/shell/shell.h>
#include <zephyr/logging/log.h>
#include <stdlib.h>

LOG_MODULE_REGISTER(app);

int main(void)
{

	return 0;
}
```
