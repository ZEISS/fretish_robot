## examples/digital_microscope/testcase.yaml
```yaml
tests:
  test.digitalmicroscope:
    harness: robotframework
    harness_config:
      robot_test_path: assets/robot_files
    extra_configs:
      - arch:posix:CONFIG_NATIVE_UART_0_ON_STDINOUT=y
    platform_allow:
      - native_sim
      - native_sim_64
    integration_platforms:
      - native_sim
      - native_sim_64
    tags:
      - test_framework
      - fret
```
